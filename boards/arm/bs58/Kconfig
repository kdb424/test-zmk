## boards/arm/bs58/Kconfig
```kconfig
#
# Copyright (c) 2022 The ZMK Contributors
# SPDX-License-Identifier: MIT
#

config BOARD_BS58_ZEN_LEFT
    bool

config BOARD_BS58_ZEN_RIGHT
    bool
```

## boards/arm/bs58/Kconfig.board
```kconfig
#
# Copyright (c) 2024 Kyle Brown
# SPDX-License-Identifier: MIT
#

config BOARD_BS58_LEFT
    bool "bs58 left"
    depends on SOC_NRF52840_QIAA

config BOARD_BS58_RIGHT
    bool "bs58 right"
    depends on SOC_NRF52840_QIAA
```
